## scripts/buildroot/bashtorio_defconfig
```kconfig
# Bashtorio Buildroot defconfig — minimal i686 for v86 emulator
# Target: 9p-root boot, serial console, BusyBox + coreutils subset

# --- Architecture ---
BR2_i386=y
BR2_x86_i686=y

# --- Toolchain ---
BR2_TOOLCHAIN_BUILDROOT_MUSL=y

# --- Kernel ---
BR2_LINUX_KERNEL=y
BR2_LINUX_KERNEL_USE_DEFCONFIG=y
BR2_LINUX_KERNEL_DEFCONFIG="i386"
BR2_LINUX_KERNEL_CONFIG_FRAGMENT_FILES="/buildroot/kernel.fragment"
BR2_LINUX_KERNEL_IMAGE_BZIMAGE=y

# --- Filesystem ---
BR2_TARGET_ROOTFS_TAR=y
# BR2_TARGET_ROOTFS_EXT2 is not set

# --- Init system ---
BR2_INIT_BUSYBOX=y

# --- BusyBox ---
BR2_PACKAGE_BUSYBOX=y

# --- Core packages ---
BR2_PACKAGE_BASH=y
BR2_PACKAGE_COREUTILS=y
BR2_PACKAGE_GREP=y
BR2_PACKAGE_SED=y
BR2_PACKAGE_GAWK=y
BR2_PACKAGE_JQ=y
BR2_PACKAGE_BC=y
BR2_PACKAGE_FILE=y
BR2_PACKAGE_TREE=y
BR2_PACKAGE_LESS=y
BR2_PACKAGE_VIM=y
BR2_PACKAGE_DIFFUTILS=y
BR2_PACKAGE_FINDUTILS=y
BR2_PACKAGE_WHICH=y

# --- Scripting ---
BR2_PACKAGE_PERL=y
BR2_PACKAGE_PYTHON3=y
BR2_PACKAGE_PYTHON3_PY_ONLY=y

# --- Fun ---
BR2_PACKAGE_FIGLET=y

# --- Networking (minimal) ---
BR2_PACKAGE_WGET=y
BR2_PACKAGE_LIBCURL=y
BR2_PACKAGE_LIBCURL_CURL=y

# --- System ---
BR2_TARGET_GENERIC_HOSTNAME="localhost"
BR2_TARGET_GENERIC_ISSUE=""
BR2_TARGET_GENERIC_GETTY_PORT="ttyS0"
BR2_TARGET_GENERIC_GETTY_BAUDRATE_115200=y
BR2_TARGET_GENERIC_ROOT_PASSWD=""
BR2_SYSTEM_DEFAULT_PATH="/usr/sbin:/usr/bin:/sbin:/bin"

# --- Stripping ---
BR2_STRIP_strip=y
```
